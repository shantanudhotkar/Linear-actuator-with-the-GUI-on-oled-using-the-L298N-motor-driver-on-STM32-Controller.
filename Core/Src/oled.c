/*
 * oled.c
 *
 *  Created on: Oct 5, 2026
 *      Author: Shantanu
 */


/* SSD1306 128x64 I2C driver, 5x7 font (A-Z, 0-9, symbols). Page addressing mode. */
#include "oled.h"
#include <string.h>

#define OLED_ADDR   (0x3C << 1)      /* use 0x3D << 1 if your module is strapped to 0x3D */

static I2C_HandleTypeDef *oled_i2c;
static uint8_t fb[8][OLED_WIDTH];    /* 8 pages x 128 columns, LSB = top pixel */

/* ASCII 32..90 (space .. Z), 5 columns per glyph, bit0 = top row */
static const uint8_t font5x7[][5] = {
  {0x00,0x00,0x00,0x00,0x00}, {0x00,0x00,0x5F,0x00,0x00}, {0x00,0x07,0x00,0x07,0x00}, {0x14,0x7F,0x14,0x7F,0x14},
  {0x24,0x2A,0x7F,0x2A,0x12}, {0x23,0x13,0x08,0x64,0x62}, {0x36,0x49,0x56,0x20,0x50}, {0x00,0x08,0x07,0x03,0x00},
  {0x00,0x1C,0x22,0x41,0x00}, {0x00,0x41,0x22,0x1C,0x00}, {0x2A,0x1C,0x7F,0x1C,0x2A}, {0x08,0x08,0x3E,0x08,0x08},
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  {0x63,0x14,0x08,0x14,0x63}, {0x03,0x04,0x78,0x04,0x03}, {0x61,0x59,0x49,0x4D,0x43}
};

static HAL_StatusTypeDef wr(uint8_t ctrl, uint8_t *d, uint16_t n)
{
  /* ctrl 0x00 = command bytes, 0x40 = display data */
  return HAL_I2C_Mem_Write(oled_i2c, OLED_ADDR, ctrl, I2C_MEMADD_SIZE_8BIT, d, n, 30);
}

void oled_init(I2C_HandleTypeDef *hi2c)
{
  static uint8_t seq[] = {
    0xAE,             /* display off */
    0xD5, 0x80,       /* clock divide */
    0xA8, 0x3F,       /* multiplex 64 */
    0xD3, 0x00,       /* display offset */
    0x40,             /* start line 0 */
    0x8D, 0x14,       /* charge pump on */
    0x20, 0x02,       /* page addressing mode */
    0xA1, 0xC8,       /* flip both axes (use 0xA0, 0xC0 if the picture is upside down) */
    0xDA, 0x12,       /* COM pins */
    0x81, 0xCF,       /* contrast */
    0xD9, 0xF1,       /* pre-charge */
    0xDB, 0x40,       /* VCOMH */
    0xA4, 0xA6,       /* follow RAM, normal (not inverted) */
    0xAF              /* display on */
  };
  oled_i2c = hi2c;
  HAL_Delay(100);                          /* let the panel power up */
  wr(0x00, seq, sizeof(seq));
  oled_clear();
  oled_flush();
}

void oled_clear(void) { memset(fb, 0, sizeof(fb)); }

void oled_flush(void)
{
  HAL_StatusTypeDef st = HAL_OK;
  for (uint8_t pg = 0; pg < 8 && st == HAL_OK; pg++)
  {
    uint8_t cmd[3] = { (uint8_t)(0xB0 | pg), 0x00, 0x10 };   /* page, column 0 */
    st = wr(0x00, cmd, 3);
    if (st == HAL_OK) st = wr(0x40, fb[pg], OLED_WIDTH);
  }
  if (st != HAL_OK)                        /* bus stuck / display unplugged: reset the peripheral */
  {
    HAL_I2C_DeInit(oled_i2c);
    HAL_I2C_Init(oled_i2c);
  }
}

void oled_pixel(int x, int y, uint8_t c)
{
  if (x < 0 || x >= OLED_WIDTH || y < 0 || y >= OLED_HEIGHT) return;
  if (c) fb[y >> 3][x] |=  (uint8_t)(1u << (y & 7));
  else   fb[y >> 3][x] &= (uint8_t)~(1u << (y & 7));
}

void oled_rect(int x, int y, int w, int h, uint8_t c)
{
  for (int j = 0; j < h; j++)
    for (int i = 0; i < w; i++)
      oled_pixel(x + i, y + j, c);
}

void oled_frame(int x, int y, int w, int h, uint8_t c)
{
  oled_rect(x, y, w, 1, c);
  oled_rect(x, y + h - 1, w, 1, c);
  oled_rect(x, y, 1, h, c);
  oled_rect(x + w - 1, y, 1, h, c);
}

void oled_char(int x, int y, char ch, uint8_t scale, uint8_t c)
{
  if (ch >= 'a' && ch <= 'z') ch -= 32;               /* lower case -> upper case */
  if (ch < 32 || ch > 'Z') ch = '?';
  const uint8_t *g = font5x7[ch - 32];
  for (int col = 0; col < 5; col++)
    for (int row = 0; row < 7; row++)
      if (g[col] & (1u << row))
        oled_rect(x + col * scale, y + row * scale, scale, scale, c);
}

void oled_text(int x, int y, const char *s, uint8_t scale, uint8_t c)
{
  for (; *s; s++, x += 6 * scale) oled_char(x, y, *s, scale, c);
}

int oled_text_width(const char *s, uint8_t scale) { return (int)strlen(s) * 6 * scale; }

void oled_text_inv(int x, int y, const char *s, uint8_t scale)
{
  oled_rect(x - 1, y - 1, oled_text_width(s, scale) + 1, 7 * scale + 2, 1);
  oled_text(x, y, s, scale, 0);
}
